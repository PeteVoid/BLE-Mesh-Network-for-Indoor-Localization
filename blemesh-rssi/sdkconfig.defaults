## blemesh-rssi/sdkconfig.defaults
```kconfig
# 로그
CONFIG_LOG_DEFAULT_LEVEL_INFO=y
CONFIG_ESP_MAIN_TASK_STACK_SIZE=8192

# Bluetooth Host: Bluedroid + BLE
CONFIG_BT_ENABLED=y
CONFIG_BT_BLE_ENABLED=y
CONFIG_BT_NIMBLE_ENABLED=n
CONFIG_BLUEDROID_ENABLED=y

# BLE Mesh
CONFIG_BLE_MESH=y
CONFIG_BLE_MESH_NODE=y
CONFIG_BLE_MESH_PROVISIONER=n
CONFIG_BLE_MESH_PB_GATT=y
CONFIG_BLE_MESH_PB_ADV=y
CONFIG_BLE_MESH_GATT_PROXY_CLIENT=n
CONFIG_BLE_MESH_GATT_PROXY_SERVER=y
CONFIG_BLE_MESH_RELAY=y
CONFIG_BLE_MESH_LOW_POWER=n
CONFIG_BLE_MESH_FRIEND=n
CONFIG_BLE_MESH_CFG_CLI=y
CONFIG_BLE_MESH_CFG_SRV=y

# Mesh 로그 수준(선택)
CONFIG_BLE_MESH_LOG_LEVEL_INFO=y
```
